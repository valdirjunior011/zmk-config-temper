## config/west.yml
```yaml
manifest:
  version: 0.8
  remotes:
    - name: zmk
      url-base: https://github.com/zmkfirmware/zmk
    - name: mctechnology17
      url-base: https://github.com/mctechnology17
  projects:
    - name: zmk
      remote: zmk
      revision: main
    - name: zmk-nice-oled
      remote: mctechnology17
      revision: main
      path: modules/lib/nice-oled
#manifest:
#  remotes:
#    - name: zmkfirmware
#      url-base: https://github.com/zmkfirmware
#    - name: m165437
#      url-base: https://github.com/m165437
#  projects:
#    - name: zmk
#      remote: zmkfirmware
#      revision: main
#      import: app/west.yml
#    - name: nice-view-gem
#      remote: m165437
#      revision: main
#  self:
#    path: config
```
